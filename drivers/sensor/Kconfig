## drivers/sensor/rv8803/Kconfig
```kconfig
config RV8803
	bool "RV8803 Real-time Clock Driver Sensor"
	default n
	depends on I2C
	help
	  Enable driver for the RV8803 Real-time Clock Driver Sensor.
```

## dts/bindings/sensor/mc,rv8803.yaml
```yaml
description: Micro Crystal RV8803 real-time clock driver sensor

compatible: "mc,rv8803"

include: ["i2c-device.yaml", "sensor-device.yaml"]

properties:
  reg:
    required: true
    description: device address on i2c bus
```
